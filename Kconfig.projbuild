## Kconfig.projbuild
```kconfig
menu "merge_wire UART <-> RS485 bridge"

    config MERGE_WIRE_ISR_IN_IRAM
        bool "Place bridge ISRs and buffers in IRAM/internal RAM"
        default y
        help
            Keeps the bridge interrupt handlers executable and their data
            reachable while the flash cache is disabled (flash writes, OTA).
            Also adds ESP_INTR_FLAG_IRAM to both interrupt allocations.
            Disable only if IRAM is scarce and no flash operations run
            while the bridge is active.


    choice MERGE_WIRE_COLLISION_POLICY
        prompt "Collision handling for the chunk on the wire"
        default MERGE_WIRE_COLLISION_RETRY
        help
            What to do with the MAIN -> RS485 chunk that was being
            transmitted when a collision was detected.

        config MERGE_WIRE_COLLISION_RETRY
            bool "Replay the chunk (commit only when verified)"
            help
                The in-flight chunk is only returned to the ring buffer once
                TX_DONE confirms it reached the wire without a clash. On a
                collision it is rewound and replayed after a randomized
                exponential backoff, up to MW_MAX_RETRIES attempts, then
                dropped. This behaves like a native CSMA node when chunks
                align with the sender's frames (idle-gap delimited traffic).

        config MERGE_WIRE_COLLISION_DROP
            bool "Drop the chunk (back off, continue with next data)"
            help
                The bridge is frame-unaware: every receiver already saw the
                corrupted frame, so replaying a possibly mid-frame slice
                cannot repair it and may inject a duplicated garbled
                fragment. This policy drops the collided chunk immediately,
                backs off with jitter to avoid re-colliding in lockstep, and
                continues with whatever is queued next, leaving recovery to
                the end-to-end protocol. MW_MAX_RETRIES has no effect.
    endchoice

    menu "Timing and thresholds"

        config MERGE_WIRE_QUIET_BITS
            int "Carrier-sense quiet window (bit times)"
            range 4 350
            default 35
            help
                How long the RS485 bus must be silent, measured in bit times
                at the RS485 baud rate, before the bridge may begin a
                transmission. The default 35 is the Modbus T3.5 inter-frame
                gap (3.5 characters). Lower grabs the bus more aggressively;
                higher is politer on busy multi-drop networks. Collision
                backoff delays are randomized multiples of this window.

        config MERGE_WIRE_DE_SETTLE_US
            int "Transceiver DE settle time (microseconds)"
            range 0 100
            default 2
            help
                Delay between asserting the transceiver's driver-enable pin
                and writing the first byte into the TX FIFO -- the UART
                transmitter starts shifting the moment a byte lands, so DE
                must be stable first. Check your transceiver's driver-enable
                time; 2 us covers common parts.

        config MERGE_WIRE_FWD_BRK_BITS
            int "Forwarded break length (bit times)"
            range 1 255
            default 12
            help
                Width of the break the bridge regenerates on the opposite
                port when it receives one. Must exceed one character frame
                (>= 10-11 bits) to register as a break at the receiver. Use
                at least 22 when bridging DMX512 at 250 kBd (break >= 88 us).

        config MERGE_WIRE_JAM_BITS
            int "Collision jam break length (0 = disabled)"
            range 0 255
            default 0
            help
                When > 0, a detected collision keeps DE asserted and jams
                the bus with a break of this many bit times so every node
                unambiguously observes the collision (CSMA/CD style;
                LocoNet jams for 15). When 0, DE drops immediately and the
                unflushable TX FIFO residue dies into the disabled driver.

        config MERGE_WIRE_MAX_RETRIES
            int "Chunk replay attempts before giving up"
            depends on MERGE_WIRE_COLLISION_RETRY
            range 1 32
            default 8
            help
                Under the replay policy: how many times a collided chunk is
                rewound and retransmitted, each attempt preceded by a
                randomized exponential backoff, before it is dropped.

        config MERGE_WIRE_FEED_CAP
            int "Max bytes per RS485 TX FIFO fill pass"
            range 16 128
            default 32
            help
                Caps how many bytes each fill adds to the RS485 TX FIFO even
                when more room exists. The TX FIFO cannot be flushed on
                UART1/2 (hardware erratum), so everything queued at the
                moment of a collision drains onto the dead bus before
                cleanup completes: 32 bytes bounds that to ~2.8 ms at
                115200 baud, where a full 128-byte FIFO costs ~11 ms.
                Streaming stays gap-free while interrupt latency is below
                the empty-threshold's worth of byte times. Does not affect
                the full-duplex port.

        config MERGE_WIRE_RXFIFO_FULL_THR
            int "RX FIFO full threshold (bytes)"
            range 1 120
            default 64
            help
                The RX interrupt fires once this many bytes accumulate.
                Larger means fewer interrupts but more forwarding latency
                and less overflow headroom (the hardware FIFO is 128 bytes).

        config MERGE_WIRE_RX_TOUT_BITS
            int "RX idle timeout (bit times)"
            range 8 200
            default 22
            help
                End-of-frame detection: the RX timeout interrupt fires after
                this much line silence with data pending in the FIFO
                (~2 characters by default). Sets frame-forwarding latency
                and feeds the carrier-sense activity clock on the RS485 side.

        config MERGE_WIRE_TXFIFO_EMPTY_THR
            int "TX FIFO empty threshold (bytes)"
            range 1 120
            default 16
            help
                Streaming top-up watermark: the TX-empty interrupt fires
                when the FIFO drains below this level, giving the ISR that
                many byte times to refill before the line goes idle.

    endmenu

endmenu
```

## examples/bridge/main/Kconfig.projbuild
```kconfig
menu "RS485 to UART Bridge Example Configuration"

    orsource "$IDF_PATH/examples/common_components/env_caps/$IDF_TARGET/Kconfig.env_caps"

    # NOTE ON UART0 (non-S3/plain ESP32 targets): On ESP32-S3 and plain ESP32 the two
    # bridge UARTs default to UART1/UART2, leaving UART0 free. On every other
    # target here (C3/C6/C61/H-series, which only have UART0 + UART1) the
    # full-duplex port falls back to UART0 which is the default console/log port.
    # There, UART0 must be freed before the bridge can use it: move the console
    # to the USB Serial/JTAG controller (CONFIG_ESP_CONSOLE_USB_SERIAL_JTAG) or
    # disable it, otherwise console output will corrupt the bridge traffic.

    config RS485_UART_PORT_NUM
        int "RS485 UART port number"
        range 0 2 if IDF_TARGET_ESP32 || IDF_TARGET_ESP32S3
        default 2 if IDF_TARGET_ESP32 || IDF_TARGET_ESP32S3
        range 0 1
        default 1
        help
            UART communication port number for the RS485 port.
            See UART documentation for available port numbers.

    config RS485_UART_BAUD_RATE
        int "UART communication speed"
        range 1200 SOC_UART_BITRATE_MAX
        default 115200
        help
            UART communication speed.

    config RS485_RX_IO
        int "RS485 RXD pin number"
        range ENV_GPIO_RANGE_MIN ENV_GPIO_IN_RANGE_MAX
        default 18 if IDF_TARGET_ESP32S3
        default 22 if IDF_TARGET_ESP32
        default 8
        help
            GPIO number for RS485 RO pin. See UART documentation for more information
            about available pin numbers for UART.

    config RS485_TX_IO
        int "RS485 TXD pin number"
        range ENV_GPIO_RANGE_MIN ENV_GPIO_OUT_RANGE_MAX
        default 17 if IDF_TARGET_ESP32S3
        default 23 if IDF_TARGET_ESP32
        default 9
        help
            GPIO number for RS485 DI pin. See UART documentation for more information
            about available pin numbers for UART.

    config RS485_DIRECTION_IO
        int "RS485 ~RE/DE pin number"
        range ENV_GPIO_RANGE_MIN ENV_GPIO_OUT_RANGE_MAX
        default 8 if IDF_TARGET_ESP32S3
        default 18 if IDF_TARGET_ESP32
        default 13 if IDF_TARGET_ESP32C6 || IDF_TARGET_ESP32C61 || IDF_TARGET_ESP32H4
        default 10
        help
            GPIO number for the pin to connected to
            ~RE/DE pin of RS485 transceiver to switch direction.
            See UART documentation for more information about available pin
            numbers for UART.

    config FULL_DUPLEX_UART_PORT_NUM
        int "Full-duplex UART port number"
        range 0 2 if IDF_TARGET_ESP32 || IDF_TARGET_ESP32S3
        default 1 if IDF_TARGET_ESP32 || IDF_TARGET_ESP32S3
        range 0 1
        default 0
        help
            UART communication port number for the full-duplex UART.
            See UART documentation for available port numbers.
            NOTE: On targets other than ESP32/ESP32-S3 this defaults to UART0,
            which is the default console. Free UART0 first (move the console to
            USB Serial/JTAG or disable it) before using it for the bridge.

    config FULL_DUPLEX_UART_BAUD_RATE
            int "Full-duplex UART communication speed"
            range 1200 SOC_UART_BITRATE_MAX
            default 115200
            help
                UART communication speed.

    config FULL_DUPLEX_UART_RX_IO
        int "Full-duplex UART RXD pin number"
        range ENV_GPIO_RANGE_MIN ENV_GPIO_IN_RANGE_MAX
        default 5 if IDF_TARGET_ESP32S3
        default 22 if IDF_TARGET_ESP32
        default 6
        help
            GPIO number for full-duplex UART RO pin. See UART documentation for more information
            about available pin numbers for UART.

    config FULL_DUPLEX_UART_TX_IO
        int "Full-duplex UART TXD pin number"
        range ENV_GPIO_RANGE_MIN ENV_GPIO_OUT_RANGE_MAX
        default 4 if IDF_TARGET_ESP32S3
        default 23 if IDF_TARGET_ESP32
        default 7
        help
            GPIO number for full-duplex UART DI pin. See UART documentation for more information
            about available pin numbers for UART.

    config FULL_DUPLEX_UART_HW_FLOWCTRL
        bool "Use HW flow control on the full-duplex UART"
        default n
        help
            Whether to enable HW flow control on the full-duplex UART port.
            Note: ESP32 UART hardware only implements RTS/CTS flow control.
            DTR/DSR below are provided for convenience but are not driven by
            the UART peripheral; handle them in software if you need them.

    config FULL_DUPLEX_UART_RTS_IO
        int "Full-duplex UART RTS pin number"
        depends on FULL_DUPLEX_UART_HW_FLOWCTRL
        range ENV_GPIO_RANGE_MIN ENV_GPIO_OUT_RANGE_MAX
        default 6 if IDF_TARGET_ESP32S3
        default 22 if IDF_TARGET_ESP32
        default 11
        help
            GPIO number for full-duplex UART RTS pin. See UART documentation for more information
            about available pin numbers for UART.

    config FULL_DUPLEX_UART_CTS_IO
        int "Full-duplex UART CTS pin number"
        depends on FULL_DUPLEX_UART_HW_FLOWCTRL
        range ENV_GPIO_RANGE_MIN ENV_GPIO_IN_RANGE_MAX
        default 7 if IDF_TARGET_ESP32S3
        default 23 if IDF_TARGET_ESP32
        default 12
        help
            GPIO number for full-duplex UART CTS pin. See UART documentation for more information
            about available pin numbers for UART.

    config FULL_DUPLEX_UART_DTR_IO
        int "Full-duplex UART DTR pin number"
        depends on FULL_DUPLEX_UART_HW_FLOWCTRL
        range ENV_GPIO_RANGE_MIN ENV_GPIO_OUT_RANGE_MAX
        default 15 if IDF_TARGET_ESP32S3
        default 25 if IDF_TARGET_ESP32
        default 14
        help
            GPIO number for full-duplex UART DTR pin (software-driven; see note above).

    config FULL_DUPLEX_UART_DSR_IO
        int "Full-duplex UART DSR pin number"
        depends on FULL_DUPLEX_UART_HW_FLOWCTRL
        range ENV_GPIO_RANGE_MIN ENV_GPIO_IN_RANGE_MAX
        default 16 if IDF_TARGET_ESP32S3
        default 26 if IDF_TARGET_ESP32
        default 21
        help
            GPIO number for full-duplex UART DSR pin (software-driven; see note above).
endmenu
```
